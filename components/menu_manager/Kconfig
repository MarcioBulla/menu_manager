## components/menu_manager/Kconfig
```kconfig
menu "Menu Menager"

config MAX_DEPTH_PATH
  int "Set max deth of submenus" 
  default 5

config SALVE_INDEX
  bool "Savel last menu index selected"
  default y

endmenu
```

## examples/menu_manager/lcd_encoder/main/Kconfig.projbuild
```kconfig
menu "Example LCD and Rotary Encoder menu_manager"

config HORIZONTAL_SIZE
  int "Set Horizontal number of caracters for your display"
  default 20

config VERTICAL_SIZE
  int "Set Vertical number of caracters for your display"
  default 4

config I2C_SDA
  int "Set I2C pin SDA number"
  default 21

config I2C_SCL
  int "Set I2C pin SCL number"
  default 22

config DISPLAY_ADDR
  hex "Set Addres of PCF8574"
  default 0x27

config ENCODER_CLK
  int "Set CLK pin Rotary Encoder"
  default 16

config ENCODER_DT
  int "Set DT pin Rotary Encoder"
  default 17

config ENCODER_SW
  int "Set SW pin Rotary Encoder"
  default 5

endmenu
```
